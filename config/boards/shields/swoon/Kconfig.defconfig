## config/boards/shields/swoon/Kconfig.defconfig
```kconfig
# Copyright (c) 2022 The ZMK Contributors
# SPDX-License-Identifier: MIT

if SHIELD_SWOON_LEFT

config ZMK_KEYBOARD_NAME
    default "swoon"

config ZMK_SPLIT_ROLE_CENTRAL
    default y

endif

if SHIELD_SWOON_LEFT || SHIELD_SWOON_RIGHT
config ZMK_SPLIT
    default y
endif
```

## config/boards/shields/swoon/Kconfig.shield
```kconfig
# Copyright (c) 2022 The ZMK Contributors
# SPDX-License-Identifier: MIT

config SHIELD_SWOON_LEFT
    def_bool $(shields_list_contains,swoon_left)

config SHIELD_SWOON_RIGHT
    def_bool $(shields_list_contains,swoon_right)
```
